## drivers/rtc/Kconfig
```kconfig
# Copyright (c) 2021
# SPDX-License-Identifier: Apache-2.0

menu "Drivers RTC"
rsource "stm32l_rtc/Kconfig"
rsource "rv3032/Kconfig"
endmenu
```

## drivers/rtc/rv3032/Kconfig
```kconfig
# Copyright (c) 2022 Farit N
# SPDX-License-Identifier: Apache-2.0

config MICROCRYSTAL_RV3032
    bool "Micro Crystal RV-3032-C7 RTC"
    depends on I2C
    help
      Enable Micro Crystal RV-3032-C7 RTC
```

## drivers/rtc/stm32l_rtc/Kconfig
```kconfig
# Copyright (c) 2022 Farit N
# SPDX-License-Identifier: Apache-2.0

config STM32L_RTC
    bool "STM32L RTC"
    depends on SOC_FAMILY_STM32
    select USE_STM32_LL_BUS
    select USE_STM32_LL_PWR
    select USE_STM32_LL_RTC
    select USE_STM32_LL_RCC
    help
      Enable STM32L RTC

if STM32L_RTC

choice STM32L_RTC_LSE_DRIVE
    prompt "LSE oscillator drive capability"

config STM32L_RTC_LSE_DRIVE_LOW
    bool "Low"
    help
      Xtal mode lower driving capability, for 6 pF crystals

config STM32L_RTC_LSE_DRIVE_MEDIUMLOW
    bool "Medium Low"
    help
      Xtal mode medium low driving capability

config STM32L_RTC_LSE_DRIVE_MEDIUMHIGH
    bool "Medium High"
    help
      Xtal mode medium high driving capability

config STM32L_RTC_LSE_DRIVE_HIGH
    bool "High"
    help
      Xtal mode higher driving capability, for 12.5 pF crystals

endchoice

config STM32L_RTC_LSE_DRIVE_STRENGTH
    hex
    default 0x00000000 if STM32L_RTC_LSE_DRIVE_LOW
    default 0x00000008 if STM32L_RTC_LSE_DRIVE_MEDIUMLOW
    default 0x00000010 if STM32L_RTC_LSE_DRIVE_MEDIUMHIGH
    default 0x00000018 if STM32L_RTC_LSE_DRIVE_HIGH

endif # STM32L_RTC
```

## drivers/sensor/Kconfig
```kconfig
# VEML7700 Ambient Light Sensor configuration options

# Copyright (c) 2021 Farit N
# SPDX-License-Identifier: Apache-2.0

menuconfig VEML7700
    bool "VEML7700 Ambient Light Sensor"
    depends on I2C
    help
      Enable driver for VEML7700 sensors.
```

## dts/bindings/adc/bmw,thermometer.yaml
```yaml
# Copyright (c) 2021, Farit N
# SPDX-License-Identifier: Apache-2.0

description: ADC thermometer for BMW E30

compatible: "bmw,thermometer"

include: base.yaml

properties:
    label:
      required: true

    io-channels:
      required: true
      description: ADC channel for temperature sensor

    enable-gpios:
      type: phandle-array
      required: true
      description: The GPIO pin that enables the thermometer. Active low.
```

## dts/bindings/gpio/bmw,clock.yaml
```yaml
# Copyright (c) 2021, Farit N
# SPDX-License-Identifier: Apache-2.0

description: The BMW E30 6-button clock

compatible: "bmw,clock"

include: base.yaml

properties:

    background-gpios:
      type: phandle-array
      required: true
      description: The GPIO pin that enables the background light. Active low.

    enable-format-gpios:
      type: phandle-array
      required: true
      description: The GPIO pin that enables clock format (Celcius/Fahrenheit and 12/24 hour) setting reading. Active how.

    fahrenheit12-gpios:
      type: phandle-array
      required: true
      description: The GPIO pin that sets the temperature in Fahrenheit and 12 hour clock

    celsius12-gpios:
      type: phandle-array
      required: true
      description: The GPIO pin that sets the temperature in Celsius and 12 hour clock

    celsius24-gpios:
      type: phandle-array
      required: true
      description: The GPIO pin that sets the temperature in Celsius and 24 hour clock
```

## dts/bindings/gpio/bmw,gong.yaml
```yaml
# Copyright (c) 2021, Farit N
# SPDX-License-Identifier: Apache-2.0

description: The gong for the BMW E30

compatible: "bmw,gong"

include: base.yaml

properties:

    t1-gpios:
      type: phandle-array
      required: true
      description: The GPIO pin that activates the gong chime t1. Active high.

    t2-gpios:
      type: phandle-array
      required: true
      description: The GPIO pin that activates the gong chime t2. Active high.
```

## dts/bindings/gpio/bmw,light.yaml
```yaml
# Copyright (c) 2021, Farit N
# SPDX-License-Identifier: Apache-2.0

description: The information cluster background light sensor for the BMW E30

compatible: "bmw,light"

include: base.yaml

properties:
    label:
      required: true

    gpios:
      type: phandle-array
      required: true
      description: The GPIO pin that enables the background light. Active low.
```

## dts/bindings/rtc/microcrystal,rv3032.yaml
```yaml
# Copyright (c) 2021 Farit N
# SPDX-License-Identifier: Apache-2.0

description:  Micro Crystal RV-3032-C7

compatible: "microcrystal,rv3032"

include: base.yaml
include: i2c-device.yaml

properties:

    int-gpios:
      type: phandle-array
      required: true
      description: The GPIO that receives interrupts from RV-3032

    nclke:
      type: int
      required: false
      default: 0x01
      description: The CLKOUT output enable bit, 0 - enabled, 1 - disabled

    bsm:
      type: int
      required: false
      default: 0x00
      description: |
        Backup power switchover modes:
        0x00: Switchover disabled 
        0x01: Direct Switching Mode (DSM)
        0x02: Level Switching Mode (LSM)
        0x03: Switchover disabled

    tcm:
      type: int
      required: false
      default: 0x00
      description: |
        Trickle Charger with Charge Pump 
        0x00: Trickle Charger off 
        0x01: 1.75 V
        0x02: 3.0 V
        0x03: 4.4 V

    tcr:
      type: int
      required: false
      default: 0x00
      description: |
        Series current limiting resistor for the trickle charger
        0x00: 1 kΩ
        0x01: 2 kΩ
        0x02: 7 kΩ
        0x03: 11 kΩ
```

## dts/bindings/rtc/st,stm32lrtc.yaml
```yaml
# Copyright (c) 2021 Farit N
# SPDX-License-Identifier: Apache-2.0

description:  STM32L RTC

compatible: "st,stm32lrtc"

include: rtc.yaml
```

## dts/bindings/sensor/vishay,veml7700.yaml
```yaml
# Copyright (c) 2021 Farit N
# SPDX-License-Identifier: Apache-2.0

description: |
    VEML7700 High Accuracy Ambient Light Sensor With I2C Interface.
    The datasheet: https://www.vishay.com/docs/84286/veml7700.pdf

compatible: "vishay,veml7700"

include: i2c-device.yaml

properties:
    als-gain:
      type: int
      required: true
      default: 0x02
      description: ALS gain selection. |
        0x00 = ALS gain x 1
        0x01 = ALS gain x 2
        0x02 = ALS gain x (1/8)
        0x03 = ALS gain x (1/4)
      enum:
        - 0x00
        - 0x01
        - 0x02
        - 0x03

    als-it:
      type: int
      required: true
      default: 0x00
      description: ALS integration time |
        0x0c = 25 ms
        0x08 = 50 ms
        0x00 = 100 ms
        0x01 = 200 ms
        0x02 = 400 ms
        0x03 = 800 ms
      enum:
        - 0x0c
        - 0x08
        - 0x00
        - 0x01
        - 0x02
        - 0x03

    als-pers:
      type: int
      required: true
      default: 0x00
      description: ALS persistence protect number |
        0x00 = 1
        0x01 = 2
        0x02 = 4
        0x03 = 8
      enum:
        - 0x00
        - 0x01
        - 0x02
        - 0x03

    psm:
      type: int
      required: true
      default: 0x00
      description: Power saving mode |
        0x00 = mode 1 
        0x01 = mode 2 
        0x02 = mode 3 
        0x03 = mode 4
      enum:
        - 0x00
        - 0x01
        - 0x02
        - 0x03
```

## west.yml
```yaml
# Copyright (c) 2021 
# SPDX-License-Identifier: Apache-2.0

manifest:
  self:
    path: e30clock

  remotes:
    - name: zephyrproject-rtos
      url-base: https://github.com/zephyrproject-rtos

  projects:
    - name: zephyr
      remote: zephyrproject-rtos
      revision: main
      import: true
```
